/*-----------------------------------------------------*/
/*本程序由Han编写，用于ESP8266的图形GUI*/
/*系统名称：HanOS*/
/*仅供学习参考*/
/*建议配合ESP8266 Expansion By Han拓展板v2.0+使用*/
/*-----------------------------------------------------*/
#include <ArduinoJson.h>
#include <Adafruit_SSD1306.h>
#include <SPI.h>
#include <Wire.h>
#include <ESP8266WiFi.h>
#include <WiFiUdp.h>
#include <NTPClient.h>
#include <ESP8266HTTPClient.h>
#include <EEPROM.h>

#define VERSION "v1.26"	/*系统版本*/

/*按键引脚定义*/
#define YES_KEY D6
#define UP_KEY D5
#define DOWN_KEY D7

#define LED D3

/*按键标志定义*/
#define YES_KEY_DOWN digitalRead(YES_KEY) == 1
#define UP_KEY_DOWN digitalRead(UP_KEY) == 1
#define DOWN_KEY_DOWN digitalRead(DOWN_KEY) == 1

#define LED_ON digitalWrite(LED, LOW);
#define LED_OFF digitalWrite(LED, HIGH);

#define GET_DATE_URL "http://quan.suning.com/getSysTime.do"
#define GET_FANS_URL "http://api.bilibili.com/x/relation/stat?vmid=385995212"
#define GET_WATCH_URL "http://api.bilibili.com/x/space/upstat?mid=385995212"

String ssid = "U-home";		/*WiFi SSID*/
String password = "MyHome_16$5334783";		/*WiFi Password*/


HTTPClient http;
WiFiClient client;
WiFiUDP ntpUDP;
NTPClient timeClient(ntpUDP, "ntp1.aliyun.com", 60 * 60 * 8, 30 * 60 * 1000);

String years = "-";
String months = "-";
String days = "-";
String temp = "-";

bool yes = false;	//确定键标志
bool up = false;	//向上键标志
bool down = false;	//向下键标志
bool hold = false;	//长按确定键标志

bool isDown_yes = false;
bool isDown_up = false;
bool isDown_down = false;
bool isDown_hold = false;

int sTime = 0, pro = 0;

/*display OLED 定义*/
Adafruit_SSD1306 display = Adafruit_SSD1306(128, 64, &Wire);

/*User Init*/
bool tIsShow = false;	//当前下拉标题显示标志
int desktop_time = 0;   //桌面时间标志
int desktop_mode = 3;
int title_y = -5;		//当前下拉标题y轴坐标

String menu_mode = "desktop_clock";
int menu_num = 1;		//主菜单中选中的列表数字
int menu_line = 1;
int menu_page = 0;		//菜单中页面的层数(0为初始页)

int an_switch_y = 1 * menu_num * 14;	//选中框当前y轴
int switch_y = an_switch_y;

int addr_desktop_mode = 0;

int start_time = 0;


/*Serial String*/

String serial_in = "";

/*时钟动画部分*/
int s_y = 27;
String last_time = "";
String now_time = "";
int y_now_time = s_y + 1;
int y_last_time = y_now_time - 20;
bool isClock_Finished = false;

String last_time_ = "";
String now_time_ = "";
int y_now_time_ = s_y + 1;
int y_last_time_ = y_now_time_ - 20;
bool isClock_Finished_ = false;

/*Game Space War部分*/
int space_player_x = 0;
int space_player_y = 20;
int space_player_shell_x[20] = { 0, 0, 0, 0, 0, 0, 0, 0, 0, 0, 0, 0, 0, 0, 0, 0, 0, 0, 0, 0 };
int space_player_shell_y[20] = { 0, 0, 0, 0, 0, 0, 0, 0, 0, 0, 0, 0, 0, 0, 0, 0, 0, 0, 0, 0 };
int space_stone_x[20] = { -1, -1, -1, -1, -1, -1, -1, -1, -1, -1, -1, -1, -1, -1, -1, -1, -1, -1, -1, -1 };
int space_stone_y[20] = { 30, 30, 30, 30, 30, 30, 30, 30, 30, 30, 30, 30, 30, 30, 30, 30, 30, 30, 30, 30 };
int space_stone_speed_x[20] = { 0, 0, 0, 0, 0, 0, 0, 0, 0, 0, 0, 0, 0, 0, 0, 0, 0, 0, 0, 0 };
int space_stone_speed_y[20] = { 0, 0, 0, 0, 0, 0, 0, 0, 0, 0, 0, 0, 0, 0, 0, 0, 0, 0, 0, 0 };
int space_war_score = 0;
bool space_isOver = false;
int timer_play = 0;
int space_over_y = 65;
int space_history_best = EEPROM.read(2);


/*Bilibili Client*/
String HotVideoHtml = "";
int fans_num = 0;
int like_num = 0;
int play_num = 0;

/*input box*/
const char text_note[] = {
	'a', 'b', 'c', 'd', 'e', 'f', 'g', 'h', 'i', 'j', 'k', 'l', 'm', 'n', 'o', 'p', 'q', 'r', 's', 't', 'u', 'v', 'w', 'x', 'y', 'z', 
	'A', 'B', 'C', 'D', 'E', 'F', 'G', 'H', 'I', 'J', 'K', 'L', 'M', 'N', 'O', 'P', 'Q', 'R', 'S', 'T', 'U', 'V', 'W', 'X', 'Y', 'Z', 
	'1', '2', '3', '4', '5', '6', '7', '8', '9', '0',
	'_', '-', '+', '=', '/', '\\', '!', '@', '#', '$', '&', '*', '(', ')', '{', '}', '[', ']', 
	'\0'
};		//字库
int text_note_length = 0;		//当前字库中的字符数量
int input_now_notice = 0;       //当前选中的字符从左到右的序数
int input_text_in = 0;			//当前选中的字符在字库中的排序
int input_text_width = 18;		//输入框最多输入的字符数量
char input_text[200];
String passportText;
String final_text;


/*WiFi Scan*/
int wifi_scan_num = 0;
String wifi_scan_label[200] = {""};
bool wifi_is_connected = false;
int EEPROM_Scan[200] = {};
int EEPROM_SSID_Scan[200] = {};

/*----------------------列表文字显示----------------------*/

String main_label[500] = {
	"Function",
	"WiFi Tool",
	"Debug",
	"System Sittings",
	""
};

String Function_label[500] = {
	"Timer",
	"Desktop Sittings",
	"Flappy Bird",
	"Space War",
	""
};

String WiFiTool_label[500] = {
	"WiFi Clock",
	"WiFi Server",
	"BiliBili",
	"WiFi Killer",
	"WiFi Info",
	"WiFi Scan",
	""
};

String Debug_label[500] = {
	"Serial Test",
	"LED Test",
	"WiFi Test",
	"OLED Test",
	"Input Box",
	""
};

String SystemSitting_label[500] = {
	"Reset",
	"System Info",
	"Start Time",
	"Shutdown",
	""
};

String SystemInfo_label[500] = {
	"System:Han OS",
	"Version:" + String(VERSION),
	"Base:ESP8266",
	"ESP-E v2.0+",
	""
};

String DesktopSittings_label[500] = {
	"Han Logo",
	"Clock",
	"Han OS Logo",
	""
};

int main_label_length = 0;
int Function_label_length = 0;
int WiFiTool_label_length = 0;
int Debug_label_length = 0;
int SystemSitting_label_length = 0;
int SystemInfo_label_length = 0;
int DesktopSittings_label_length = 0;


/*-------------------------------------------------------*/

int text_x_l[4] = { 10, 10, 10, 10 };	//4列列表x轴坐标

/*Logo bitmap定义*/
const unsigned char HAN_LOGO[] PROGMEM = { 0x00,0x00,0x00,0x00,0x00,0x00,0x00,0x00,0x00,0x00,0x00,0x00,0x00,0x00,0x00,0x00,
0x00,0x00,0x00,0x00,0x00,0x00,0x00,0x00,0x00,0x00,0x00,0x00,0x00,0x00,0x00,0x00,
0x00,0x00,0x00,0x00,0x00,0x00,0x00,0x00,0x00,0x00,0x00,0x00,0x00,0x00,0x00,0x00,
0x00,0x00,0x00,0x00,0x00,0x00,0x00,0x00,0x00,0x00,0x00,0x00,0x00,0x00,0x00,0x00,
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0x00,0x00,0x00,0x00,0x00,0x00,0x00,0x00,0x00,0x00,0x00,0x00,0x00,0x00,0x00,0x00 };

const unsigned char HanOS_Logo[] PROGMEM = { 0x00,0x00,0x00,0x00,0x00,0x00,0x00,0x00,0x00,0x00,0x00,0x00,0x00,0x00,0x00,0x00,
0x00,0x00,0x00,0x00,0x00,0x00,0x00,0x00,0x00,0x00,0x00,0x00,0x00,0x00,0x00,0x00,
0x00,0x00,0x00,0x00,0x00,0x00,0x00,0x00,0x00,0x00,0x00,0x00,0x00,0x00,0x00,0x00,
0x00,0x00,0x00,0x00,0x00,0x00,0x00,0x00,0x00,0x00,0x00,0x00,0x00,0x00,0x00,0x00,
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0x00,0x00,0x00,0x00,0x00,0x00,0x00,0x00,0x00,0x00,0x00,0x00,0x00,0x00,0x00,0x00 };


void setup() {
	/*OLED初始化*/
	display.begin(SSD1306_SWITCHCAPVCC, 0x3C);

	display.clearDisplay();
	display.display();
	display.setTextSize(1);
	display.setTextColor(SSD1306_WHITE);

	Serial.begin(115200);

	/*EEPROM Init*/
	EEPROM.begin(512);
	read_desktop_mode();

	/*WiFi Init*/
	WiFi.mode(WIFI_STA);
	WiFi.begin(ssid, password);

	timeClient.begin();

	//http.begin(GET_DATE_URL);
	http.setTimeout(5000);

	/*按键初始化*/
	pinMode(YES_KEY, INPUT);
	pinMode(UP_KEY, INPUT);
	pinMode(DOWN_KEY, INPUT);

	pinMode(LED, OUTPUT);
	LED_OFF;

	//Serial.print(desktop_mode);
	//Serial.print(EEPROM.read(1));

	for (int i = 0; Function_label[i] != ""; i++) {
		Function_label_length++;
	}
	for (int i = 0; WiFiTool_label[i] != ""; i++) {
		WiFiTool_label_length++;
	}
	for (int i = 0; Debug_label[i] != ""; i++) {
		Debug_label_length++;
	}
	for (int i = 0; SystemSitting_label[i] != ""; i++) {
		SystemSitting_label_length++;
	}
	for (int i = 0; SystemInfo_label[i] != ""; i++) {
		SystemInfo_label_length++;
	}
	for (int i = 0; DesktopSittings_label[i] != ""; i++) {
		DesktopSittings_label_length++;
	}
	for (int i = 0; text_note[i] != '\0'; i++) {
		text_note_length++;
	}

	/*OLED开机进度条*/
	start_animation();
	if (!wifi_is_connected) {
		wifi_scan_update();
		menu_mode = "wifi_scan";

		int overTime = millis() / 1000;

		while (WiFi.status() != WL_CONNECTED) {
			overTime = millis() / 1000;
			display.clearDisplay();
			wifi_show_connect();
			display.display();
			KEY_scan();

			if (yes) {
				//input_box(wifi_scan_label[menu_num]);
				WiFi.begin(wifi_scan_label[menu_num], password);
				yes = false;
				Serial.println("yes");
				break;
			}
		}

		while (WiFi.status() != WL_CONNECTED || overTime <= 10);

		Serial.println("OverTime");

		while (WiFi.status() != WL_CONNECTED) {
			KEY_scan();

			display.clearDisplay();

			input_box(wifi_scan_label[menu_num - 1]);

			if (hold) {
				WiFi.begin(wifi_scan_label[menu_num - 1], passportText);
				Serial.println("Hold on");
				Serial.println(wifi_scan_label[menu_num - 1]);
				Serial.println(passportText);
				break;
			}

			display.display();

			hold = false;
			yes = false;
		}

		while (1);
	}

	update_fans_num();
	//desktop_mode = EEPROM.read(addr_desktop_mode);
}

void loop() {
	OLED_display();
	timeClient.update();
}

/*--------------------------用户子函数部分--------------------------*/

/*
OLED_display()  OLED显示屏显示主函数
OLED显示程序伪入口
*/
void OLED_display() {
	display.clearDisplay();

	if (yes || hold) {
		LED_ON;
	}

	else {
		LED_OFF;
	}

	if (yes && tIsShow && menu_mode == "desktop") {
		menu_mode = "main_menu";
		yes = false;
	}

	else if (yes && tIsShow && menu_mode == "desktop_clock") {
		menu_mode = "main_menu";
		yes = false;
	}

	else if (yes && tIsShow && menu_mode == "desktop_OSLogo") {
		menu_mode = "main_menu";
		yes = false;
	}

	else if (hold && menu_mode != "desktop" && menu_mode != "desktop_clock" && menu_mode != "desktop_OSLogo" && menu_mode != "shutdown") {
		if (menu_mode == "main_menu") {
			if (desktop_mode == 1)
				menu_mode = "desktop";
			else if (desktop_mode == 2)
				menu_mode = "desktop_clock";
			else if (desktop_mode == 3)
				menu_mode = "desktop_OSLogo";
		}
		else if (menu_mode == "sub_menu")
			menu_mode = "main_menu";
		else
			menu_mode = "sub_menu";

		hold = false;
		yes = false;
	}

	else if (yes && menu_mode == "sub_menu" && menu_num == 1 && menu_line == 2) {
		menu_mode = "clock";
		get_years();
		yes = false;
	}

	else if (yes && menu_mode == "sub_menu" && menu_num == 1 && menu_line == 4) {
		while (1);
		yes = false;
	}

	else if (yes && menu_mode == "sub_menu" && menu_num == 2 && menu_line == 4) {
		menu_mode = "system_info";
		yes = false;
	}

	else if (yes && menu_mode == "sub_menu" && menu_num == 4 && menu_line == 4) {
		menu_mode = "shutdown";
		yes = false;
	}

	else if (yes && menu_mode == "sub_menu" && menu_num == 3 && menu_line == 4) {
		menu_mode = "start_time";
		yes = false;
	}

	else if (yes && menu_mode == "sub_menu" && menu_num == 2 && menu_line == 1) {
		menu_mode = "desktop_sittings";
		yes = false;
	}

	else if (yes && menu_mode == "sub_menu" && menu_num == 5 && menu_line == 2) {
		menu_mode = "wifi_info";
		yes = false;
	}

	else if (yes && menu_mode == "sub_menu" && menu_num == 1 && menu_line == 3) {
		menu_mode = "serial_test";
		yes = false;
	}

	else if (yes && menu_mode == "sub_menu" && menu_num == 4 && menu_line == 1) {
		menu_mode = "space_war";
		space_war_init();
		space_history_best = EEPROM.read(2);
		yes = false;
	}

	else if (yes && menu_mode == "sub_menu" && menu_num == 3 && menu_line == 2) {
		menu_mode = "bilibili";
		show_bilibili_client();
		update_fans_num();
	}

	else if (yes && menu_mode == "desktop_sittings" && menu_page == 0) {
		desktop_mode = menu_num;
		EEPROM.write(1, desktop_mode);
		EEPROM.commit();
		//Serial.print(EEPROM.read(1));
		if (desktop_mode == 1)
			menu_mode = "desktop";
		else if (desktop_mode == 2)
			menu_mode = "desktop_clock";
		else if (desktop_mode == 3)
			menu_mode = "desktop_OSLogo";
		yes = false;
	}

	else if (yes && menu_mode == "sub_menu" && menu_num == 5 && menu_line == 3) {
		menu_mode = "input_box";
		yes = false;
	}

	else if (yes && menu_mode == "sub_menu" && menu_num == 6 && menu_line == 2) {
		WiFi.disconnect();
		yes = false;

		pro = 0;

		for (int i = 0; i < input_text_width; i++) {
			EEPROM.write(i + 3, 255);
		}

		EEPROM.commit();

		setup();
		//setup();
	}

	/*------------------------------*/

	if (menu_mode == "desktop")
		show_desktop();

	else if (menu_mode == "desktop_clock")
		show_desktop_clock();

	else if (menu_mode == "desktop_OSLogo")
		show_desktop_OSlogo();

	else if (menu_mode == "main_menu") {
		if (yes && menu_mode == "main_menu") {
			menu_mode = "sub_menu";
			menu_line = menu_num;
		}
		else {
			show_menu("Main Menu");
			menu_mode = "main_menu";
		}
		yes = false;
	}
	else if (menu_mode == "sub_menu")
		show_menu(main_label[menu_line - 1]);
	else if (menu_mode == "clock") {
		show_clock();
		ctrl_title("Clock", true);
	}

	else if (menu_mode == "system_info")
		show_system_info();

	else if (menu_mode == "shutdown") {
		display.fillScreen(SSD1306_BLACK);
		if (hold)
			while (1);
		yes = false;
		up = false;
		down = false;
		hold = false;
	}

	else if (menu_mode == "start_time") {
		show_system_start_time();
	}

	else if (menu_mode == "desktop_sittings") {
		switch_desktop();
	}

	else if (menu_mode == "wifi_info") {
		show_wifi_info();
	}

	else if (menu_mode == "serial_test") {
		serial_test();
	}

	else if (menu_mode == "space_war") {
		game_space_war();
	}

	else if (menu_mode == "bilibili") {
		show_bilibili_client();
		if (millis() % 1000 == 0) {
			update_fans_num();
		}
	}

	else if (menu_mode == "input_box") {
		input_box("Password");
	}

	yes = false;
	up = false;
	down = false;
	hold = false;

	KEY_scan();

	display.display();
}

/*
show_desktop()  桌面显示函数
*/
void show_desktop() {
	display.drawBitmap(0, 10, HAN_LOGO, 128, 64, SSD1306_WHITE);

	desktop_time++;

	if (desktop_time >= 150)
		ctrl_title("Desktop", false);
	else
		ctrl_title("Desktop", true);

	if (yes && menu_mode == "desktop")
		desktop_time = 0;
}

void show_desktop_clock() {
	show_clock();

	desktop_time++;

	if (desktop_time >= 150) {
		ctrl_title("Desktop", false);
	}

	else {
		ctrl_title("Desktop", true);
	}

	if (yes && menu_mode == "desktop_clock")
		desktop_time = 0;
}

void show_desktop_OSlogo() {
	display.drawBitmap(0, 10, HanOS_Logo, 128, 64, SSD1306_WHITE);

	desktop_time++;

	if (desktop_time >= 150)
		ctrl_title("Desktop", false);
	else
		ctrl_title("Desktop", true);

	if (yes && menu_mode == "desktop_OSLogo")
		desktop_time = 0;
}

void show_menu(String title) {
	display.setTextSize(1);
	display.setCursor(10, 0);
	display.print(title);

	display.drawRect(0, 8, 128, 64 - 8, 1);
	show_menu_label();
	change_page();
}

void show_menu_label() {
	if (menu_num <= 4)
		an_switch_y = menu_num * 14;
	else {
		if(menu_num % 4 != 0)
			an_switch_y = (menu_num % 4) * 14;
		else
			an_switch_y = 4 * 14;
	}
		
	int text_target_x = 20;

	display.fillRect(125, switch_y - 6, 15, 14, 1);
	display.fillRect(0, switch_y - 6, 10, 14, 1);

	display.drawLine(0, switch_y - 6, 125, switch_y - 6, 1);
	display.drawLine(0, switch_y + 7, 125, switch_y + 7, 1);
	display.setTextSize(1);

	if (switch_y < an_switch_y)
		switch_y += 2;
	else if (switch_y > an_switch_y)
		switch_y -= 2;

	for (int i = 0; i < 4; i++) {
		int y = (i + 1) * 14;

		display.setTextColor(1);
		display.setTextSize(1);

		if ((i + 1) == (menu_num % 4) || (i + 1) == menu_num) {
			if (text_x_l[i] < text_target_x)
				text_x_l[i]++;
			else if (text_x_l[i] > text_target_x)
				text_x_l[i]--;
		}

		else {
			if (text_x_l[i] < 10)
				text_x_l[i]++;
			else if (text_x_l[i] > 10)
				text_x_l[i]--;
		}

		display.setCursor(text_x_l[i], y - 2);

		if (menu_mode == "main_menu") {
			if (menu_num > 4)
				menu_num = 4;
			display.print(main_label[i]);
		}
			
		else if (menu_mode == "sub_menu") {
			switch (menu_line) {
			case 1:
				display.print(Function_label[i]);
				break;
			case 2:
				if (WiFiTool_label[i] == "" && menu_num >= i + 1) {
					menu_num = i;
				}
				if (menu_num > WiFiTool_label_length)
					menu_num = WiFiTool_label_length;
				/*if (menu_num % 4 == 0 || menu_num <= 4)
					display.print(wifi_scan_label[i]);
				else*/
				if (menu_num % 4 == 0)
					display.print(WiFiTool_label[i + ((menu_num - 1) / 4) * 4]);
				else
					display.print(WiFiTool_label[i + (menu_num / 4) * 4]);
				break;
			case 3:
				if (Debug_label[i] == "" && menu_num >= i + 1) {
					menu_num = i;
				}

				if (menu_num > Debug_label_length)
					menu_num = Debug_label_length;
				if (menu_num <= 4)
					display.print(Debug_label[i]);
				else
					display.print(Debug_label[i + menu_num - 1]);
				break;
			case 4:
				display.print(SystemSitting_label[i]);
				break;
			}
		}
		else if (menu_mode == "system_info") {
			switch (menu_line) {
			case 1:
				break;
			case 2:
				break;
			case 3:
				break;
			case 4:
				display.print(SystemInfo_label[i]);
				break;
			}
		}

		else if (menu_mode == "desktop_sittings") {
			switch (menu_line) {
			case 1:
				display.print(DesktopSittings_label[i]);
				if (DesktopSittings_label[i] == "" && menu_num >= i + 1) {
					menu_num = i;
				}
				break;
			case 2:
				break;
			case 3:
				break;
			case 4:
				break;
			}
		}

		else if (menu_mode == "wifi_scan") {
				if (wifi_scan_label[i] == "" && menu_num >= i + 1) {
					menu_num = i;
				}
				if (menu_num > wifi_scan_num)
					menu_num = wifi_scan_num;
				/*if (menu_num % 4 == 0 || menu_num <= 4)
					display.print(wifi_scan_label[i]);
				else*/
				if(menu_num % 4 == 0)
					display.print(wifi_scan_label[i + ((menu_num - 1) / 4) * 4]);
				else
					display.print(wifi_scan_label[i + (menu_num / 4) * 4]);
				//Serial.println(i + ((menu_num - 1) / 4) * 4);
		}
	}
}

void change_page() {
	if (menu_mode != "desktop") {
		//menu_page = menu_num / 4;
		if (up) {
			menu_num--;
			up = false;
		}
		else if (down) {
			menu_num++;
			down = false;
		}

		//if (menu_num > 4) {
		//	menu_num = 4;
		//	menu_page++;
		//}


		if (menu_num < 1) {
			menu_num = 1;
			//menu_page--;
		}

		/*if (menu_page < 0) {
			menu_page = 0;
		}*/
	}
}

/*
ctrl_title(String title, bool isShow) 下拉标题函数
title(String):标题内容
isShow(true~false):下拉标题是否隐藏
*/
void ctrl_title(String title, bool isShow) {
	if (isShow && !tIsShow) {
		if (title_y < 8)
			title_y++;
		else if (title_y == 8)
			tIsShow = true;
	}

	else if (!isShow && tIsShow) {
		if (title_y > -5)
			title_y--;
		else if (title_y == -5)
			tIsShow = false;
	}

	display.drawLine(0, title_y, 128, title_y, SSD1306_WHITE);
	display.setTextSize(1);
	display.setCursor(4, title_y - 8);
	display.print(title);
}

/*
KEY_scan() 按键扫描函数
yes(true~false):确定键标志
up(true~false):向上键标志
down(true~false):向下键标志
！需要调用后自行将相应的按键标志复位！
*/
void KEY_scan() {
	/*判断确定键是否按下*/
	if (YES_KEY_DOWN) {
		if (isDown_yes == false) {
			//yes = true;
			isDown_yes = true;
		}

		/*显示长按提示进度条*/
		if (isDown_hold == false) {
			sTime += 5;
			if (sTime >= 3 * 30 && menu_mode != "desktop" && menu_mode != "desktop_clock" && menu_mode != "desktop_OSLogo" && menu_mode != "shutdown") {
				pro += 5;
			}
			else {
				pro -= 6;
				if (pro < 0)
					pro = 0;
			}

			//display.display();

			if (sTime >= 128 + 3 * 30) {
				hold = true;
				isDown_hold = true;
				sTime = 0;
				pro = 0;
				isDown_yes = true;
				//yes = false;
			}
		}
	}

	else {
		if (sTime < 3 * 30 && isDown_yes == true && isDown_hold == false) {
			yes = true;
			sTime = 0;
		}

		if (sTime >= 3 * 30 && sTime <= 128 + 3 * 30) {
			yes = false;
			pro -= 7;
			if (pro < 0) {
				pro = 0;
				sTime = 0;
			}
		}

		isDown_yes = false;
		isDown_hold = false;
	}
	
	show_progress(pro, 7);

	/*判断向上键是否按下*/
	if (UP_KEY_DOWN && isDown_up == false) {
		up = true;
		isDown_up = true;
	}

	if (UP_KEY_DOWN == false)
		isDown_up = false;

	/*判断向下键是否按下*/
	if (DOWN_KEY_DOWN && isDown_down == false) {
		down = true;
		isDown_down = true;
	}

	if (DOWN_KEY_DOWN == false)
		isDown_down = false;
}

/*
start_animation()  开机动画
*/
void start_animation() {
	int pro = 0;

	for (int y = -64; y <= 64; y += 2) {
		display.clearDisplay();

		display.drawBitmap(0, y, HAN_LOGO, 128, 64, SSD1306_WHITE);

		display.setCursor(90, y - 64 + 46);
		display.setTextSize(1);
		display.print(VERSION);

		display.drawBitmap(0, y - 64, HanOS_Logo, 128, 64, SSD1306_WHITE);

		display.display();
	}

	Serial.println();
	Serial.println("             ___               ___");
	Serial.println("            /  / \\            /  /");
	Serial.println("           /  /\\  \\          /  /");
	Serial.println("          /  /  \\  \\        /  /");
	Serial.println("         /  /    \\  \\      /  /");
	Serial.println("        /  / ___________  /  /");
	Serial.println("       /  / /__________/ /  /");
	Serial.println("      /  /              /  /");
	Serial.println("     /  /      \\  \\    /  /");
	Serial.println("    /  /        \\  \\  /  /");
	Serial.println("   /  /          \\  \\/  /");
	Serial.println("  /__/            \\ /__/");
	Serial.println("            Han OS");

	delay(1000);

	while (pro <= 128 || WiFi.status() != WL_CONNECTED) {
		display.clearDisplay();
		show_progress(pro, 60);

		display.drawBitmap(0, 0, HanOS_Logo, 128, 64, SSD1306_WHITE);

		display.setCursor(90, 0 + 46);
		display.setTextSize(1);
		display.print(VERSION);

		//display.display();
		if (WiFi.status() != WL_CONNECTED && !Serial.available())
			pro += 1;
		else
			pro += 2;

		if (millis() / 1000 >= 10) {
			wifi_is_connected = false;
			break;
			//display.clearDisplay();
			//wifi_show_connect();
		}
		else if(WiFi.status() != WL_CONNECTED)
			wifi_is_connected = true;

		display.display();
	}

	get_years();
}

/*
show_progress()进度条
value(0~128):进度
y(0~64):进度条y轴坐标
*/
void show_progress(int value, int y) {
	if(value != 0)
		display.drawLine(-1, y, value, y, SSD1306_WHITE);
	//Serial.println(value);
}

void get_years() {
	http.begin(GET_DATE_URL);
	int httpCode = http.GET();
	String str = "";
	if (httpCode > 0) {
		if (httpCode == HTTP_CODE_OK) {
			str = http.getString();

			years = str.substring(13, 17);
			months = str.substring(18, 20);
			days = str.substring(21, 23);
			//temp = str.substring(215, 217);
		}
	}
	//Serial.println(httpCode);
	http.end();
}

String get_days() {
	//Serial.println(timeClient.getDay());
	switch (timeClient.getDay()) {
	case 0:
		return "Sun";
		break;
	case 1:
		return "Mon";
		break;
	case 2:
		return "Tue";
		break;
	case 3:
		return "Wed";
		break;
	case 4:
		return "Thu";
		break;
	case 5:
		return "Fri";
		break;
	case 6:
		return "Sat";
		break;
	}
}

void show_clock() {
	if (last_time != timeClient.getFormattedTime().substring(7, 8)) {
		if (y_now_time > s_y)
			y_now_time -= 1;
		if (y_now_time == s_y) {
			y_now_time = s_y + 25;
			isClock_Finished = true;
		}
		y_last_time = y_now_time - 25;
	}

	if (last_time_ != timeClient.getFormattedTime().substring(6, 7)) {
		if (y_now_time_ > s_y)
			y_now_time_ -= 1;
		if (y_now_time_ == s_y) {
			y_now_time_ = s_y + 25;
			isClock_Finished_ = true;
		}
		y_last_time_ = y_now_time_ - 25;
	}

	/*秒显示*/
	display.setTextSize(2);
	display.setCursor(110, y_now_time);

	display.print(timeClient.getFormattedTime().substring(7, 8));

	display.setCursor(110, y_last_time);
	display.print(last_time);

	if (isClock_Finished) {
		last_time = timeClient.getFormattedTime().substring(7, 8);
		isClock_Finished = false;
	}

	/*---------*/

	display.setTextSize(2);
	display.setCursor(97, y_now_time_);
	display.print(timeClient.getFormattedTime().substring(6, 7));

	display.setCursor(97, y_last_time_);
	display.print(last_time_);

	if (isClock_Finished_) {
		last_time_ = timeClient.getFormattedTime().substring(6, 7);
		isClock_Finished_ = false;
	}


	display.fillRect(87, s_y + 15, 110, s_y + 5, SSD1306_BLACK);
	display.fillRect(87, s_y - 25, 110, s_y - 10, SSD1306_BLACK);


	/*小时显示*/
	display.setTextSize(3);
	display.setCursor(3, 20);
	display.print(timeClient.getFormattedTime().substring(0, 5));

	display.drawLine(0, 50, 128, 50, SSD1306_WHITE);

	/*日期显示*/
	display.setTextSize(1);
	display.setCursor(3, 55);
	display.print(years);
	display.print(".");
	display.print(months);
	display.print(".");
	display.print(days);

	/*星期显示*/
	display.setTextSize(1);
	display.setCursor(100, 55);
	display.print(get_days());

	/*display.setTextSize(1);
	display.setCursor(95, 55);
	display.print(temp + "deg");*/
}

void show_system_info() {
	show_menu(SystemSitting_label[2 - 1]);
	//show_menu_label();
}

void show_system_start_time() {
	ctrl_title(SystemSitting_label[3 - 1], true);

	display.setTextSize(1);

	display.setCursor(0, 16);
	display.print("Time(h):");
	display.print(start_time / 1000 / 60 / 60);

	display.setCursor(0, 28);
	display.print("Time(m):");
	display.print(start_time / 1000 / 60);

	display.setCursor(0, 40);
	display.print("Time(s):");
	display.print(start_time / 1000);

	display.setCursor(0, 52);
	display.print("Time(ms):");
	display.print(start_time);

	start_time = millis();
}

void switch_desktop() {
	show_menu(Function_label[2 - 1]);
}

void show_wifi_info() {
	ctrl_title(WiFiTool_label[4 - 1], true);
	display.setCursor(0, 16);
	display.setTextSize(1);

	display.println();
	display.print("SSID:");
	display.println(ssid);
	display.println();

	display.print("PWD:");
	display.println(password);
	display.println();

	display.print("IP:");
	display.println(WiFi.localIP());
}

void serial_test() {
	ctrl_title(Debug_label[1 - 1], true);

	display.setCursor(0, 20);
	display.setTextSize(1);

	display.println("Get Info:");

	if (Serial.available())
		serial_in = Serial.readString();

	display.print(serial_in);
}

void update_fans_num() {
	http.begin(client, GET_FANS_URL);
	int httpCode = http.GET();
	if (httpCode == HTTP_CODE_OK) {
		String getStr = http.getString();
		//Serial.println(getStr);
		DynamicJsonDocument  jsonBuffer(2400);
		deserializeJson(jsonBuffer, getStr);
		JsonObject getJS = jsonBuffer.as<JsonObject>();
		fans_num = getJS["data"]["follower"];
	}
	http.end();
}

void game_space_war() {
	ctrl_title(Function_label[4 - 1] + "       " + String(space_war_score), true);

	if (!space_isOver) {
		timer_play = millis();
		if (UP_KEY_DOWN) {
			space_player_y -= 1;
		}
		if (DOWN_KEY_DOWN) {
			space_player_y += 1;
		}

		if (space_player_y >= 64 - 8)
			space_player_y = 64 - 8;
		else if (space_player_y <= 0 + 13)
			space_player_y = 13;

		display.fillRoundRect(space_player_x, space_player_y, 4, 8, 2, SSD1306_WHITE);
		display.fillRect(space_player_x + 5, space_player_y + 2, 3, 4, SSD1306_WHITE);

		if (yes) {
			for (int i = 0; i < 20; i++) {
				if (space_player_shell_x[i] == 0) {
					space_player_shell_x[i] += 2;
					space_player_shell_y[i] = space_player_y + 4;
					break;
				}
			}
		}

		for (int i = 0; i < 20; i++) {
			if (space_player_shell_x[i] != 0) {
				space_player_shell_x[i] += 2;
				display.fillCircle(space_player_shell_x[i] + 10, space_player_shell_y[i], 1, SSD1306_WHITE);
				if (space_player_shell_x[i] >= 128)
					space_player_shell_x[i] = 0;
			}
		}

		if (random(0, 30) == 20) {
			for (int i = 0; i < 20; i++) {
				if (space_stone_x[i] == -1) {
					space_stone_x[i] = 140;
					space_stone_speed_x[i] = random(1, 2);
					space_stone_speed_y[i] = random(-1, 1);
					space_stone_y[i] = random(15, 60);
					break;
				}
			}
		}

		for (int i = 0; i < 20; i++) {
			if (space_stone_x[i] != -1) {
				space_stone_x[i] -= space_stone_speed_x[i];
				space_stone_y[i] += space_stone_speed_y[i];
				if (space_stone_y[i] >= 64 - 5 || space_stone_y[i] <= 13)
					space_stone_speed_y[i] *= -1;
				display.fillRect(space_stone_x[i], space_stone_y[i], 4, 4, SSD1306_WHITE);

				if (space_stone_x[i] <= 0 - 4)
					space_stone_x[i] = -1;

				if (space_stone_x[i] <= 10 && space_stone_y[i] >= space_player_y - 4 && space_stone_y[i] <= space_player_y + 4) {
					space_isOver = true;
				}

				for (int j = 0; j < 20; j++) {
					if (space_player_shell_x[j] != 0 && space_player_shell_y[j] != 0 && space_stone_x[i] != -1 && space_stone_y[i] != -1) {
						if (space_player_shell_x[j] >= space_stone_x[i] - 2 && space_player_shell_x[j] <= space_stone_x[i] + 2) {
							if (space_player_shell_y[j] >= space_stone_y[i] - 2 && space_player_shell_y[j] <= space_stone_y[i] + 3) {
								space_stone_x[i] = -1;
								space_player_shell_x[j] = 0;
								space_war_score++;
							}
						}
					}
				}
			}
		}
	}

	else {
		ctrl_title(Function_label[4 - 1] + "       " + String(space_war_score), true);
		if (space_war_score > space_history_best) {
			EEPROM.write(2, space_war_score);
			EEPROM.commit();
			space_history_best = space_war_score;
		}

		if (space_over_y >= 25)
			space_over_y -= 1;

		display.setCursor(10, space_over_y);
		display.setTextSize(2);
		display.print("Game Over");

		display.setCursor(10, space_over_y + 20);
		display.setTextSize(1);
		display.print("Score:" + String(space_war_score) + "   Best:" + String(space_history_best));

		display.setCursor(10, space_over_y + 30);
		display.setTextSize(1);
		display.print("Click OK Continue");

		if (space_over_y <= 25) {
			if (yes) {
				space_war_init();
			}
		}
	}
}

void space_war_init() {
	for (int i = 0; i < 20; i++) {
		space_player_shell_x[i] = 0;
		space_player_shell_y[i] = 0;
		space_stone_x[i] = -1;
		space_stone_y[i] = 30;
		space_stone_speed_x[i] = 0;
		space_stone_speed_y[i] = 0;
	}
	space_war_score = 0;
	space_player_x = 0;
	space_player_y = 20;
	space_isOver = false;
	space_over_y = 65;
	space_history_best = EEPROM.read(2);
}

void show_bilibili_client() {
	ctrl_title("Bilibili Client", true);
	display.setCursor(2, 20);
	display.print("Follower Number:");
	display.setTextSize(2);
	display.setCursor(2, 30);
	display.print(fans_num);
	display.setTextSize(1);
}

void update_bilibili_hotVideo() {
	http.begin(client, GET_WATCH_URL);
	int httpCode = http.GET();
	if (httpCode == HTTP_CODE_OK) {
		HotVideoHtml = http.getString();
		Serial.println("HTML:"+HotVideoHtml);
		DynamicJsonDocument  jsonBuffer(5600);
		deserializeJson(jsonBuffer, HotVideoHtml);
		JsonObject getJS = jsonBuffer.as<JsonObject>();
		Serial.println(HotVideoHtml);
		//fans_num = getJS["data"]["follower"];
	}

	else {
		Serial.println(httpCode);
	}
	http.end();
}

void input_box(String title) {
	ctrl_title(title, true);

	display.setCursor(0, 25);
	display.print("Password");

	if (up) {
		if (input_text_in < text_note_length - 1)
			input_text_in++;
		else
			input_text_in = 0;
		up = false;
	}

	else if (down) {
		if (input_text_in > 0)
			input_text_in--;
		else
			input_text_in = text_note_length - 1;
		down = false;
	}

	for (int x = 0; x < input_text_width; x++) {
		if (x == input_now_notice)
			input_text[x] = text_note[input_text_in];
	}

	for (int x = 0; x < input_text_width; x++) {
		passportText += input_text[x];
	}

	display.setCursor(8, 38);
	display.print(passportText);

	display.drawRoundRect(0, 35, 127, 13, 3, SSD1306_WHITE);

	if (!hold)
		passportText = "";

	//Serial.println(input_now_notice);
}

void wifi_scan_update() {
	WiFi.disconnect();
	wifi_scan_num = WiFi.scanNetworks();

	for (int i = 0; i < wifi_scan_num; i++) {
		wifi_scan_label[i] = WiFi.SSID(i);
		//Serial.println(WiFi.SSID(i));
	}

	/*display.clearDisplay();

	display.setCursor(10, 25);
	display.print("WiFi disconnect");*/
}

void wifi_show_connect() {
	show_menu("WiFi Scan");
}

void read_desktop_mode() {
	desktop_mode = EEPROM.read(1);
	if (desktop_mode == 1)
		menu_mode = "desktop";
	else if (desktop_mode == 2)
		menu_mode = "desktop_clock";
	else if (desktop_mode == 3)
		menu_mode = "desktop_OSLogo";
}
